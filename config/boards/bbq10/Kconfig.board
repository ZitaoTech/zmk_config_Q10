## config/boards/bbq10/Kconfig.board
```kconfig
# Copyright (c) 2023 ZitaoTech
# SPDX-License-Identifier: MIT

config BOARD_BBQ10
    bool "bbq10"
    depends on SOC_NRF52840_QIAA
```

## config/boards/bbq10/Kconfig.defconfig
```kconfig
# Copyright (c) 2023 ZitaoTech
# SPDX-License-Identifier: MIT

if BOARD_BBQ10

config ZMK_KEYBOARD_NAME
    default "bbq10"

if USB_DEVICE_STACK

config USB_NRFX
    default y

endif # USB_DEVICE_STACK

if ZMK_BACKLIGHT

config PWM
    default y

config LED_PWM
    default y

endif # ZMK_BACKLIGHT

config BT_CTLR
    default BT

endif # BOARD_BBQ10
```
